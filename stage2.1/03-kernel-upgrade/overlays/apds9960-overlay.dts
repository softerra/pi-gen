// Definitions for apds9960 module
/dts-v1/;
/plugin/;

/ {
	compatible = "brcm,bcm2708";


        fragment@0 {
                target = <&i2c_arm>;
                __overlay__ {
                        #address-cells = <1>;
                        #size-cells = <0>;
                        status = "okay";

                        apds9960: apds9960@39 {
                            compatible = "avago,apds9960";
                            reg = <0x39>;
                            interrupt-parent = <&gpio>;
                            interrupts = <17 1>;
                        };
                };
        };

    __overrides__ {
        intpin = <&apds9960>,"interrupts:0";
    };
};
